## conf/layer.conf
```bitbake
# We have a conf and classes directory, add to BBPATH
BBPATH .= ":${LAYERDIR}"

# We have recipes-* directories, add to BBFILES
BBFILES += "${LAYERDIR}/recipes-*/*/*.bb \
            ${LAYERDIR}/recipes-*/*/*.bbappend"

BBFILE_COLLECTIONS += "meta-geeking-bsp"
BBFILE_PATTERN_meta-geeking-bsp = "^${LAYERDIR}/"
BBFILE_PRIORITY_meta-geeking-bsp = "6"

LAYERDEPENDS_meta-geeking-bsp = "core"
LAYERSERIES_COMPAT_meta-geeking-bsp = "dunfell"
```
